## wic/imx8-uboot-bootpart.wks
```
# short-description: Create SD card image with a boot partition
# long-description:
# Create an image that can be written onto a SD card using dd for use
# with i.MX8 SoC family
# It uses imx-boot
#
# The disk layout used is:
#  - --------- -------------- --------------
# | | u-boot  |     boot     |    rootfs   |
#  - --------- -------------- --------------
# ^ ^         ^              ^
# | |         |              |
# 0 33kiB    8MiB          64MiB + rootfs + IMAGE_EXTRA_SPACE (default 10MiB)
#
part u-boot --source rawcopy --sourceparams="file=imx-boot-imx8mqevk-sd.bin" --ondisk mmcblk --no-table --align 33
part /boot --source bootimg-partition --ondisk mmcblk --fstype=vfat --label boot --active --align 8192 --size 64
part / --source rootfs --ondisk mmcblk --fstype=ext4 --label root --align 8192

bootloader --ptable msdos
```
